## IDF/hello_world/sdkconfig.defaults
```kconfig
# ESP32-S3 N16R8 configuration
CONFIG_IDF_TARGET="esp32s3"

# Flash - 16MB
CONFIG_ESPTOOLPY_FLASHSIZE_16MB=y
CONFIG_ESPTOOLPY_FLASHSIZE="16MB"

# PSRAM - 8MB OPI
CONFIG_SPIRAM=y
CONFIG_SPIRAM_MODE_OCT=y
CONFIG_SPIRAM_SPEED_80M=y
CONFIG_SPIRAM_BOOT_INIT=y
```

## IDF/i2s_mic_speaker/sdkconfig.defaults
```kconfig
# Target: ESP32-S3 N16R8
CONFIG_IDF_TARGET="esp32s3"

# Flash: 16MB
CONFIG_ESPTOOLPY_FLASHSIZE_16MB=y
CONFIG_ESPTOOLPY_FLASHSIZE="16MB"

# PSRAM: 8MB Octal SPI
CONFIG_SPIRAM=y
CONFIG_SPIRAM_MODE_OCT=y
CONFIG_SPIRAM_SPEED_80M=y
```
